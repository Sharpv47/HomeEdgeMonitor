## firmware/sdkconfig.defaults
```kconfig
# ESP32-S3 DevKitC-1 N8R8
# Project defaults required for the HomeEdge firmware

# 8 MB physical flash
CONFIG_ESPTOOLPY_FLASHSIZE_8MB=y
CONFIG_ESPTOOLPY_FLASHSIZE="8MB"

# Custom OTA partition layout
CONFIG_PARTITION_TABLE_CUSTOM=y
CONFIG_PARTITION_TABLE_CUSTOM_FILENAME="partitions.csv"
CONFIG_PARTITION_TABLE_FILENAME="partitions.csv"
CONFIG_PARTITION_TABLE_OFFSET=0x8000
CONFIG_ESP_HTTPS_OTA_ALLOW_HTTP=y
CONFIG_BOOTLOADER_APP_ROLLBACK_ENABLE=y
```
